## shared/rpi3-custom/build/conf/bblayers.conf
```bitbake
# POKY_BBLAYERS_CONF_VERSION is increased each time build/conf/bblayers.conf
# changes incompatibly
POKY_BBLAYERS_CONF_VERSION = "2"

BBPATH = "${TOPDIR}"
BBFILES ?= ""

BBLAYERS ?= " \
  /shared/yocto/poky/meta \
  /shared/yocto/poky/meta-poky \
  /shared/yocto/meta-openembedded/meta-oe \
  /shared/yocto/meta-openembedded/meta-multimedia \
  /shared/yocto/meta-openembedded/meta-networking \
  /shared/yocto/meta-openembedded/meta-perl \
  /shared/yocto/meta-openembedded/meta-python \
  /shared/yocto/meta-qt5 \
  /shared/yocto/meta-raspberrypi \
  /shared/yocto/meta-security \
  /shared/rpi3-custom/meta-rpi \
  "

BBLAYERS_NON_REMOVABLE ?= " \ 
  /shared/yocto/poky/meta \
  /shared/yocto/poky/meta-poky \  
  "
```
